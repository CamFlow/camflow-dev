## security/ifc/Kconfig
```kconfig
config SECURITY_IFC
         bool "CamFlow - IFC"
         depends on SECURITY
         select SECURITYFS
         select CRYPTO_BLOWFISH_X86_64
         default n
         help
          This selects IFC.
          The IFC security module enforce DIFC.
```

## security/provenance/Kconfig
```kconfig
config SECURITY_PROVENANCE
         bool "CamFlow - Provenance"
         depends on SECURITY
         depends on NET
         depends on INET
         select RELAY
         select SECURITY_NETWORK
         select SECURITYFS
         select NETFILTER
         select CRYPTO_SHA256
         default y
         help
          This selects CamFlow provenance related modules. It captures provenance through
          a Linux Security Module.

config SECURITY_PROVENANCE_WHOLE_SYSTEM
	bool "CamFlow - Whole system provenance"
	depends on SECURITY_PROVENANCE
	default n
	help
	  This option activates whole system provenance capture from boot.

	  If you are unsure how to answer this question, answer N.

config SECURITY_PROVENANCE_PERSISTENCE
	bool "CamFlow - Persistence"
	depends on SECURITY_PROVENANCE
	default n
	help
	  This option persists inode provenance states across reboots.

	  If you are unsure how to answer this question, answer N.
```
